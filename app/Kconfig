## app/Kconfig
```kconfig
config APP_HEARTBEAT_PERIOD_MS
    int "Heartbeat LED period (ms)"
    default 500
    range 100 2000
    help
      Time between heartbeat LED toggles.

source "Kconfig.zephyr"
```
